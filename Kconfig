## Kconfig
```kconfig
config SENSOR_XYZ
    bool "Fake XYZ accelerometer"
    depends on SENSOR
    default y

config SENSOR_XYZ_RATE_HZ
    int "Sampling rate"
    default 100
    range 1 1600
```

## dts/bindings/sensor,xyz.yaml
```yaml
description: Fake XYZ accelerometer

compatible: "sensor,xyz"

properties:
  label:
    type: string
    required: true

  odr-hz:
    type: int
    default: 100
```
